# cpld register map
Registers from a debugger description file.
Registers are 16-bit, access not given, no defined reset value unless marked. A register's access mark holds for its fields unless they carry their own. Addresses are absolute; registers are grouped by the start of their names; lines under a group give offsets from that group; [hi:lo] are bit positions; {n}, {i} and the like mark numbered series; 'fields as' and 'values as' point back to an identical list; <NAME> marks a mode.

## SF
0x1000000 SF_PWM
0x1000002 SF_EN

## LIGHT
0x1000010 LIGHT_GREEN
0x1000014 LIGHT_RED

## SHOCK
0x1000020 SHOCK_PLUS_FRONT
0x1000022 SHOCK_PLUS_BACK

## SONGSHA
0x1000030 SONGSHA_R
0x1000032 SONGSHA_L

## LJD
0x1000040 LJD_CLK
0x1000042 LJD_REF
0x1000044 LJD_DIR

## LJZ1
0x1000048 LJZ1_CLK
0x100004A LJZ1_REF
0x100004C LJZ1_DIR

## LJZ2
0x1000050 LJZ2_CLK
0x1000052 LJZ2_REF
0x1000054 LJZ2_DIR

## RJD
0x1000058 RJD_CLK
0x100005A RJD_REF
0x100005C RJD_DIR

## RJZ1
0x1000060 RJZ1_CLK
0x1000062 RJZ1_REF
0x1000064 RJZ1_DIR

## RJZ2
0x1000068 RJZ2_CLK
0x100006A RJZ2_REF
0x100006C RJZ2_DIR

## QD
0x1000070 QD_UP
0x1000072 QD_DOWM
0x1000074 QD_SC

## NEEDLE
0x1000076 NEEDLE_CW
0x1000078 NEEDLE_CCW

## SFR
0x1000012 LGHT_YELLOW
0x1000016 DAY_LIGHT_LAMP
0x1000034 LOU_LA
0x1000080 ALM0_INPUT
0x1000082 ALM1_INPUT
0x1000084 ALL2_INPUT
0x1000090 YARN_OUT_CRT
